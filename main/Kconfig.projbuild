## main/Kconfig.projbuild
```kconfig
menu "CONTROLLER Configuration"
    choice CONTROLLER_USE_ETHERNET
        prompt "Ethernet Type"
        default CONTROLLER_USE_INTERNAL_ETHERNET if IDF_TARGET_ESP32
        default CONTROLLER_USE_DM9051 if !IDF_TARGET_ESP32
        help
            Select which kind of Ethernet will be used in the CONTROLLER.

        config CONTROLLER_USE_INTERNAL_ETHERNET
            depends on IDF_TARGET_ESP32
            select ETH_USE_ESP32_EMAC
            bool "Internal EMAC"
            help
                Select internal Ethernet MAC controller.

        config CONTROLLER_USE_DM9051
            bool "DM9051 Module"
            select ETH_USE_SPI_ETHERNET
            select ETH_SPI_ETHERNET_DM9051
            help
                Select external SPI-Ethernet module.
    endchoice

    if CONTROLLER_USE_INTERNAL_ETHERNET
        choice CONTROLLER_ETH_PHY_MODEL
            prompt "Ethernet PHY Device"
            default CONTROLLER_ETH_PHY_IP101
            help
                Select the Ethernet PHY device to use in the CONTROLLER.

            config CONTROLLER_ETH_PHY_IP101
                bool "IP101"
                help
                    IP101 is a single port 10/100 MII/RMII/TP/Fiber Fast Ethernet Transceiver.
                    Goto http://www.icplus.com.tw/pp-IP101G.html for more information about it.

            config CONTROLLER_ETH_PHY_RTL8201
                bool "RTL8201/SR8201"
                help
                    RTL8201F/SR8201F is a single port 10/100Mb Ethernet Transceiver with auto MDIX.
                    Goto http://www.corechip-sz.com/productsview.asp?id=22 for more information about it.

            config CONTROLLER_ETH_PHY_LAN8720
                bool "LAN8720"
                help
                    LAN8720A is a small footprint RMII 10/100 Ethernet Transceiver with HP Auto-MDIX Support.
                    Goto https://www.microchip.com/LAN8720A for more information about it.

            config CONTROLLER_ETH_PHY_DP83848
                bool "DP83848"
                help
                    DP83848 is a single port 10/100Mb/s Ethernet Physical Layer Transceiver.
                    Goto http://www.ti.com/product/DP83848J for more information about it.
        endchoice

        config CONTROLLER_ETH_MDC_GPIO
            int "SMI MDC GPIO number"
            default 23
            help
                Set the GPIO number used by SMI MDC.

        config CONTROLLER_ETH_MDIO_GPIO
            int "SMI MDIO GPIO number"
            default 18
            help
                Set the GPIO number used by SMI MDIO.
    endif

    if CONTROLLER_USE_DM9051
        config CONTROLLER_DM9051_SPI_HOST
            int "SPI Host Number"
            range 0 2
            default 1
            help
                Set the SPI host used to communicate with DM9051.

        config CONTROLLER_DM9051_SCLK_GPIO
            int "SPI SCLK GPIO number"
            range 0 33
            default 19
            help
                Set the GPIO number used by SPI SCLK.

        config CONTROLLER_DM9051_MOSI_GPIO
            int "SPI MOSI GPIO number"
            range 0 33
            default 23
            help
                Set the GPIO number used by SPI MOSI.

        config CONTROLLER_DM9051_MISO_GPIO
            int "SPI MISO GPIO number"
            range 0 33
            default 25
            help
                Set the GPIO number used by SPI MISO.

        config CONTROLLER_DM9051_CS_GPIO
            int "SPI CS GPIO number"
            range 0 33
            default 22
            help
                Set the GPIO number used by SPI CS.

        config CONTROLLER_DM9051_SPI_CLOCK_MHZ
            int "SPI clock speed (MHz)"
            range 20 80
            default 20
            help
                Set the clock speed (MHz) of SPI interface.

        config CONTROLLER_DM9051_INT_GPIO
            int "Interrupt GPIO number"
            default 4
            help
                Set the GPIO number used by DM9051 interrupt.
    endif

    config CONTROLLER_ETH_PHY_RST_GPIO
        int "PHY Reset GPIO number"
        default 5
        help
            Set the GPIO number used to reset PHY chip.
            Set to -1 to disable PHY chip hardware reset.

    config CONTROLLER_ETH_PHY_ADDR
        int "PHY Address"
        range 0 31 if CONTROLLER_USE_INTERNAL_ETHERNET
        range 1 1 if !CONTROLLER_USE_INTERNAL_ETHERNET
        default 1
        help
            Set PHY address according your board schematic.

    config CONTROLLER_LED_LINES
        int "number of LED lines supported"
        range 1 8
        default 2
        help
            Number of LED lines supported

    config CONTROLLER_LED_LINE0
        int "LED line 0 GPIO number"
        default 16
        range 0 33
        help
            Set the GPIO number used to send the serial data for the LED line 0

    if CONTROLLER_LED_LINES >= 2
        config CONTROLLER_LED_LINE1
            int "LED line 1 GPIO number"
            default 32
            range 0 33
            help
                Set the GPIO number used to send the serial data for the LED line 1
    endif
    
    if CONTROLLER_LED_LINES >= 3
        config CONTROLLER_LED_LINE2
            int "LED line 2 GPIO number"
            default 4
            range 0 33
            help
                Set the GPIO number used to send the serial data for the LED line 2
    endif
    
    if CONTROLLER_LED_LINES >= 4
        config CONTROLLER_LED_LINE3
            int "LED line 3 GPIO number"
            default 12
            range 0 33
            help
                Set the GPIO number used to send the serial data for the LED line 3
    endif
    
    if CONTROLLER_LED_LINES >= 5
        config CONTROLLER_LED_LINE4
            int "LED line 4 GPIO number"
            default 13
            range 0 33
            help
                Set the GPIO number used to send the serial data for the LED line 4
    endif
    
    if CONTROLLER_LED_LINES >= 6
        config CONTROLLER_LED_LINE5
            int "LED line 5 GPIO number"
            default 14
            range 0 33
            help
                Set the GPIO number used to send the serial data for the LED line 5
    endif
    
    if CONTROLLER_LED_LINES >= 7
        config CONTROLLER_LED_LINE6
            int "LED line 6 GPIO number"
            default 15
            range 0 33
            help
                Set the GPIO number used to send the serial data for the LED line 6
    endif
    
    if CONTROLLER_LED_LINES >= 8
        config CONTROLLER_LED_LINE7
            int "LED line 7 GPIO number"
            default 17
            range 0 33
            help
                Set the GPIO number used to send the serial data for the LED line 7
    endif
    
endmenu
```
